## Kconfig
```kconfig
# Copyright (c) 2026, FocalTech Systems CO.,Ltd
# SPDX-License-Identifier: Apache-2.0

config HAS_FT9001_HAL
	bool
	default y if SOC_FT9001
	help
	  Register-level support library for the FocalTech FT9001. Enabled by the
	  SoC; the individual USE_FT9001_HAL_* symbols below pick which parts are
	  compiled in.

if HAS_FT9001_HAL

config USE_FT9001_HAL_CPM
	bool
	help
	  Clock and power management: system clock source, high-speed oscillator
	  trim, bus dividers.

config USE_FT9001_SYSTEM_INIT
	bool
	select USE_FT9001_HAL_CPM
	help
	  CMSIS SystemInit() and SystemCoreClockUpdate() for platforms that boot
	  through the vendor startup path instead of soc_early_init_hook().

endif # HAS_FT9001_HAL
```
